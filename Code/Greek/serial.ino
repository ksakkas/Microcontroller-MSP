/*
Αυτός ο κωδικός σχεδιάστηκε από τον Κωνσταντίνο Σάκκα στις 7 Αυγούστου 2020.
Προορίζεται για ακαδημαϊκή χρήση στο Τμήμα Πληροφορικής και Τηλεπικοινωνιών του Πανεπιστημίου
Ιωαννίνων και του github https://ksakkas.github.io/Microcontroller-MSP430/.
*/
/*
Αυτός ο κωδικός σχεδιάστηκε και εκτελέστηκε στο Energia ver. 1.8.11E23
Σχεδιάστηκε για χρήση με TI MSP430F5529
*/

//Σειριακή και led

void setup() {                   //Συνάρτηση αρχικοποίησης παραμέτρων και υλικών συστήματος.
                                //Αρχικοποιήση σειριακής θύρας: 
Serial.begin(9600);            //Είναι ο ρυθμός μετάδοσης σε bits ανά δευτερόλεπτο (για Serial).
pinMode(RED_LED,OUTPUT);      //Δηλώση RED_LED ως έξοδο 
Serial.println("Do you want to turn on the led ");   //Εμφάνιση μηνύματος στην αρχή του προγράμματος
Serial.println("press  1  to turn on, 2 to shut off"); //Εμφάνιση μηνύματος στην αρχή του προγράμματος
while(!Serial.available())  //Σε αυτό το βήμα, χρησιμοποιώντας την εντολή if ελέγχει εάν η σειριακή δεν είναι διαθέσιμη.
{};                     
}

void loop() {         //Κύρια επαναλαμβανόμενη συνάρτηση
if(Serial.available()){    //Σε αυτό το βήμα, χρησιμοποιώντας την εντολή if ελέγχει εάν η σειριακή είναι διαθέσιμη.
  int x =  Serial.parseInt(); //Διαβάζει από τη σειριακή και το μετατρέπει σε ακέραιο
  if(x==1)                   //Αν το x = 1
  {
    digitalWrite(RED_LED, HIGH);  //Δίνει λογική τιμή 1 (HIGH) στο led, δηλαδή το ανάβει.
  }
  else if (x==2)           //Αλλιώς αν x = 2
  {
    digitalWrite(RED_LED, LOW); //Δίνει λογική τιμή 0 (LOW) στο led, δηλαδή το απενεργοποιεί.
  }
  else                  //Αλλιώς
  {
      Serial.printl("Give 1 or 2"); //Εμφάνιση μηνύματος στην σειριακή
  }
}
}