/*
Αυτός ο κωδικός σχεδιάστηκε από τον Κωνσταντίνο Σάκκα στις 7 Αυγούστου 2020.
Προορίζεται για ακαδημαϊκή χρήση στο Τμήμα Πληροφορικής και Τηλεπικοινωνιών του Πανεπιστημίου
Ιωαννίνων και του github https://ksakkas.github.io/Microcontroller-MSP430/.
*/
/*
Αυτός ο κωδικός σχεδιάστηκε και εκτελέστηκε στο Energia ver. 1.8.11E23
Σχεδιάστηκε για χρήση με TI MSP430F5529
*/

/*
Κατά τη διάρκεια της κανονικής ροής του προγράμματος, το κόκκινο LED (PIN 1.0) 
θα αναβοσβήνει με συχνότητα 1 Hz. Ο μικροελεγκτής θα τυπώνει στην σειριακή κονσόλα 
το πλήθος των αφεσβέσεων

Όταν ο χρήστης πιέζει το δεξί button (PIN 1.1), θα σταματάει η ροή του προγράμματος. 
Όταν ο χρήστης ξαναπιέσει το button θα συνεχίζει
*/

#define LED RED_LED //Δηλώνουμε οτι θα χρησιμοποιήσουμε το κόκκινο led
const int button = PUSH2;  //Αρχικοποιούμε στην σταθερά button το κουμπί PUSH2 (P1.1)
const int led  = RED_LED;  //Αρχικοποιούμε στην σταθερά led το κόκκινο led (P1.0)

int ledState=LOW;           //Αρχικοποιούμε την μεταβλητή ledState = LOW δηλαδή λογικό 0
                           //Η συγκεκριμένη μεταβλητή θα κρατάει την κατάσταση του led
int buttonCurrent=LOW;    //Αρχικοποιούμε την μεταβλητή buttonCurrent = LOW δηλαδή λογικό 0
                         //Η συγκεκριμένη μεταβλητή θα κρατάει την κατάσταση του κουμπιού
int buttonPrevious=LOW; //Αρχικοποιούμε την μεταβλητή buttonPrevious = LOW δηλαδή λογικό 0
                       //Η συγκεκριμένη μεταβλητή θα κρατάει την προηγούμενη κατάσταση του κουμπιού
int x=0;              //Αρχικοποιούμε την μεταβλητή x = 0 για μετρητή

void setup() {                                                       //Συνάρτηση αρχικοποίησης παραμέτρων και υλικών συστήματος
  Serial.begin(9600);                                               //Είναι ο ρυθμός μετάδοσης σε bits / sec 
  pinMode(led, OUTPUT);                                            //Δήλωση σταθεράς led = RED_LED ως έξοδο
  pinMode(button, INPUT_PULLUP);                                  //Δήλωση σταθεράς button = PUSH2 ως έξοδο
  Serial.println("Τμήμα Πληροφορικής & Τηλεπικοινωνιών");        //Εμφάνιση μηνύματος στην έναρξη του προγράμματος 
  Serial.println("Project Button");                     //Εμφάνιση μηνύματος στην έναρξη του προγράμματος 

  
}

void loop()                                                        //Κύρια επαναληπτική συνάρτηση
{
  buttonCurrent = digitalRead(button);                           //Εκχώρηση στην μεταβλητή buttonCurrent την τιμή του Button (εαν πατήθηκε ή όχι)
  if (buttonCurrent != buttonPrevious)                          //Εαν η τιμή του buttonCurrent είναι διαφορετική απο την τιμή του buttonPrevious τότε 
                                                               //(δηλ. εαν η τιμή της τωρινής κατάστασης είναι διαφορετική απο της προηγούμενης)
  {
    if(buttonCurrent == HIGH)                                //Εαν η τιμή του buttonCurrent είναι HIGH = λογικό 1 τότε
    {
      if(ledState == LOW){                                 //Εαν η τιμή του ledState είναι LOW = λογικό 0 τότε
        while(buttonCurrent == HIGH){                     //Όσο η τιμή του buttonCurrent είναι HIGH = λογικό 1
          digitalWrite(led, HIGH);                       //Δίνει λογική τιμή 1 (HIGH) στο led δηλαδή το ανάβει
          delay(500);                                   //Σταματά την εκτέλεση για 500 ms = 0.5 sec  
          digitalWrite(led, LOW);                      //Δίνει λογική τιμή 0 (LOW) στο led δηλαδή το σβήνει
          delay(500);                                 //Σταματά την εκτέλεση για 500 ms = 0.5 sec 
          x++;                                       //Αυξάνει το μετρητή κατά ένα
          Serial.print("Το LED έχει αναβοσβήσει: ");//Εμφάνιση μηνύματος
          Serial.print(x);                         //Εμφάνιση τιμής του μετρητή x
          Serial.println(" φορές");               //Εμφάνιση μηνύματος
          buttonCurrent = digitalRead(button);   //Εκχώρηση στην μεταβλητή buttonCurrent την τιμή του Button (εαν πατήθηκε ή όχι)
          }
        ledState=HIGH;                         //Η μεταβλητή της κατάστασης του led γίνεται HIGH δηλαδή λογικό 1
      }
      else{                                  //Αλλιώς (εάν δεν ισχύει η προηγούμενη συνθήκη)
          digitalWrite(led, LOW);           //Δίνει λογική τιμή 0 (LOW) στο led δηλαδή το σβήνει
          ledState= LOW;                   //Η μεταβλητή της κατάστασης του led γίνεται LOW δηλαδή λογικό 0
          Serial.println("Το LED σταμάτησε να αναβοσβήνει ");    //Εμφάνιση μηνύματος
      }
    }
       buttonPrevious = buttonCurrent;  //Στην μεταβλητή που κρατάει την προηγούμενη κατάσταση του button εκχωρούμε την κατάσταση του button
  }
}